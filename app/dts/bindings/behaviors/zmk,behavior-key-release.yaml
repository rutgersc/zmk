## app/dts/bindings/behaviors/zmk,behavior-key-release.yaml
```yaml
# Copyright (c) 2022 The ZMK Contributors
# SPDX-License-Identifier: MIT

description: Key release behavior

compatible: "zmk,behavior-key-release"

include: one_param.yaml
```
